## 03_menuconfig/main/Kconfig.projbuild
```kconfig
menu "Custom configuration"

	config StringValue
		string "String value"
		default "test"
		help
			Test for a string value.

	config IntValue
		int "Int value"
		default 1
		help
			Test for a int value.	

	config HexValue
		hex "Hex value"
		default 1
		help
			Test for a hex value.

	config BoolValue
		bool "Bool value"
		help
			Test for a bool value.		

	choice
		prompt "Choice Value"
		default CHOICE_2
		help
			Test for a choice element
		config CHOICE_1
			bool "First choice"
		config CHOICE_2
			bool "Second choice"
		config CHOICE_3
			bool "Third choice"
	endchoice
		
endmenu
```

## 04_httpclient/main/Kconfig.projbuild
```kconfig
menu "Example configuration"

	config WIFI_SSID
		string "WIFI Network SSID"
		help
			Enter the SSID of the wifi network

	config WIFI_PASSWORD
		string "WIFI Network Password"
		help
			Enter the password of the wifi network

	config WEBSITE
		string "Target website"
		default "www.google.com"
		help
			Enter the address of the target website
	
	config RESOURCE
		string "Website resource"
		default "/"
		help
			Enter the resource URL
	
endmenu
```

## 07_gpio_interrupts/main/Kconfig.projbuild
```kconfig
menu "Example Configuration"

config BUTTON_PIN
    int "Number of the PIN connected to the BUTTON"
	range 0 34
	default 0

config LED_PIN
    int "Number of the PIN connected to the LED"
	range 0 34
	default 5


endmenu
```

## 08_sms_send/main/Kconfig.projbuild
```kconfig
menu "Example configuration"

config WIFI_SSID
    string "Wifi SSID"
	default "mywifi"

config WIFI_PASSWORD
    string "Wifi password"
	default "mypassword"

config BUTTON_PIN
    int "Number of the PIN connected to the BUTTON"
	range 0 34
	default 0

config BULKSMS_USER
    string "BulkSMS username"
	default "bulkuser"

config BULKSMS_PASSWORD
    string "BulkSMS password"
	default "bulkpassword"

config SMS_TEXT
    string "Text to send via SMS"
	default "Hello+world!"
	
config SMS_RECIPIENTS
	string "Recipients of the SMS"
	default "12345678"
	
endmenu
```

## 09_mdns/main/Kconfig.projbuild
```kconfig
menu "Wifi Configuration"

config WIFI_SSID
    string "WiFi SSID"
	default "myssid"
	help
		SSID (network name) for the example to connect to.

config WIFI_PASSWORD
    string "WiFi Password"
	default "myssid"
	help
		WiFi password (WPA or WPA2) for the example to use.

		Can be left blank if the network has no security set.

endmenu

menu "mDNS Configuration"
		
config MDNS_HOSTNAME
    string "mDNS Hostname"
	default "esp32"
	help
		mDNS Hostname

config MDNS_INSTANCE
    string "mDNS Instance"
	default "ESP32 Demo Board"
	help
		mDNS Instance

endmenu
```

## 10_ifttt_maker/main/Kconfig.projbuild
```kconfig
menu "Example configuration"

config WIFI_SSID
    string "Wifi SSID"
	default "mywifi"

config WIFI_PASSWORD
    string "Wifi password"
	default "mypassword"

config BUTTON_PIN
    int "Number of the PIN connected to the BUTTON"
	range 0 34
	default 0
	
endmenu
```

## 11_sntp/main/Kconfig.projbuild
```kconfig
menu "Example configuration"

config WIFI_SSID
    string "Wifi SSID"
	default "mywifi"

config WIFI_PASSWORD
    string "Wifi password"
	default "mypassword"

config SNTP_SERVER
    string "SNTP Server"
	default "pool.ntp.org"
	
endmenu
```

## 12_accesspoint/main/Kconfig.projbuild
```kconfig
menu "Access Point configuration"

	config AP_SSID
		string "Wifi SSID"
		default "esp32-ap"
		help
			SSID for the Access Point Wifi network (max 31 chars)

	config AP_PASSWORD
		string "Wifi password"
		help
			Password for the Wifi network (if needed)

	config AP_CHANNEL
		int "Wifi channel"
		default 0
		help
			Channel for the Wifi network
	
	choice
		prompt "Authentication mode"
		default WIFI_AUTH_WPA2_PSK
		help
			Authentication mode for the Wifi network
		config WIFI_AUTH_OPEN
			bool "Open"
		config WIFI_AUTH_WEP
			bool "WEP"
		config WIFI_AUTH_WPA_PSK
			bool "WPA-PSK"
		config WIFI_AUTH_WPA2_PSK
			bool "WPA2-PSK"
		config WIFI_AUTH_WPA_WPA2_PSK
			bool "WPA-PSK or WPA2-PSK"
		config WIFI_AUTH_WPA2_ENTERPRISE
			bool "WPA2 Enterprise"			
	endchoice
	
	config AP_HIDE_SSID
		bool "Hide SSID"
		default 0
		help
			Hide SSID
	
	config AP_MAX_CONNECTIONS
		int "Maximum concurrent connections"
		range 1 4
		default 4
		help
			Maximum number of concurrent connections (1-4)
	
	config AP_BEACON_INTERVAL	
		int "Beacon interval (ms)"
		range 100 60000
		default 100
		help
			Beacon interval in ms (100-60000)
			
endmenu
```

## 14_basic_webserver/main/Kconfig.projbuild
```kconfig
menu "Example configuration"

config WIFI_SSID
    string "Wifi SSID"
	default "mywifi"

config WIFI_PASSWORD
    string "Wifi password"
	default "mypassword"

config RELAY_PIN
    int "Number of the PIN connected to the RELAY"
	range 0 34
	default 0
	
endmenu
```

## 15_ssl_webserver/firmware/main/Kconfig.projbuild
```kconfig
menu "Example configuration"

	config AP_SSID
		string "Wifi SSID"
		default "esp32-ap"
		help
			SSID for the Access Point Wifi network (max 31 chars)

	config AP_PASSWORD
		string "Wifi password"
		help
			Password for the Wifi network (if needed)

	config RELAY_PIN
		int "Number of the PIN connected to the RELAY"
		range 0 34
		default 0
	
endmenu
```

## 16_spiffs/main/Kconfig.projbuild
```kconfig
menu "SPIFFS partition configuration"

config SPIFFS_BASE_ADDR
    hex "SPIFFS Base address"
    range 100000 1FFE000
    default 180000
    help
	Starting address of the SPIFFS area in ESP32 Flash

config SPIFFS_SIZE
    int "SPIFFS Size in bytes"
    range 262144 2097152
    default 1048576

config SPIFFS_LOG_BLOCK_SIZE
    int "SPIFFS Logical block size"
    range 4098 65536
    default 8192

config SPIFFS_LOG_PAGE_SIZE
    int "SPIFFS Logical page size"
    range 256 2048
    default 256
    help
	Set it to the phisycal page size og the used SPI Flash chip.

endmenu
```

## 23_ap_http/main/Kconfig.projbuild
```kconfig
menu "Access Point configuration"

	config AP_SSID
		string "Wifi SSID"
		default "esp32-ap"
		help
			SSID for the Access Point Wifi network (max 31 chars)

	config AP_PASSWORD
		string "Wifi password"
		help
			Password for the Wifi network (if needed)

	config AP_CHANNEL
		int "Wifi channel"
		default 0
		help
			Channel for the Wifi network
	
	choice
		prompt "Authentication mode"
		default WIFI_AUTH_WPA2_PSK
		help
			Authentication mode for the Wifi network
		config WIFI_AUTH_OPEN
			bool "Open"
		config WIFI_AUTH_WEP
			bool "WEP"
		config WIFI_AUTH_WPA_PSK
			bool "WPA-PSK"
		config WIFI_AUTH_WPA2_PSK
			bool "WPA2-PSK"
		config WIFI_AUTH_WPA_WPA2_PSK
			bool "WPA-PSK or WPA2-PSK"
		config WIFI_AUTH_WPA2_ENTERPRISE
			bool "WPA2 Enterprise"			
	endchoice
	
	config AP_HIDE_SSID
		bool "Hide SSID"
		default 0
		help
			Hide SSID
	
	config AP_MAX_CONNECTIONS
		int "Maximum concurrent connections"
		range 1 4
		default 4
		help
			Maximum number of concurrent connections (1-4)
	
	config AP_BEACON_INTERVAL	
		int "Beacon interval (ms)"
		range 100 60000
		default 100
		help
			Beacon interval in ms (100-60000)		
endmenu


menu "SPIFFS partition configuration"

config SPIFFS_BASE_ADDR
    hex "SPIFFS Base address"
    range 100000 1FFE000
    default 180000
    help
	Starting address of the SPIFFS area in ESP32 Flash

config SPIFFS_SIZE
    int "SPIFFS Size in bytes"
    range 262144 2097152
    default 1048576

config SPIFFS_LOG_BLOCK_SIZE
    int "SPIFFS Logical block size"
    range 4098 65536
    default 8192

config SPIFFS_LOG_PAGE_SIZE
    int "SPIFFS Logical page size"
    range 256 2048
    default 256
    help
	Set it to the phisycal page size og the used SPI Flash chip.
endmenu
```

## 25_ibeacon_finder/main/Kconfig.projbuild
```kconfig
menu "iBeacon finder configuration"

config IBEACON_UUID
    string "iBeacon UUID"

config MIN_RSSI
    int "Min RSSI to consider the iBeacon found"
	default -50	
	
config TIMEOUT
    int "Timeout (in milliseconds)"
	default 10000

config LED_PIN
    int "PIN connected to the LED"
	range 0 34
	default 0
	
endmenu
```
